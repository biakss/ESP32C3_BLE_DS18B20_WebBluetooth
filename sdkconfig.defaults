## sdkconfig.defaults
```kconfig
# --- BLE / NimBLE support for ESP32-C3 ---
CONFIG_BT_ENABLED=y
CONFIG_BT_BLE_ENABLED=y
CONFIG_BT_NIMBLE_ENABLED=y
CONFIG_BT_CLASSIC_ENABLED=n
CONFIG_BT_CTRL_MODE_BLE_ONLY=y
CONFIG_BT_NIMBLE_ROLE_PERIPHERAL=y
CONFIG_BT_NIMBLE_ROLE_BROADCASTER=y
CONFIG_BT_NIMBLE_ROLE_CENTRAL=y
CONFIG_BT_NIMBLE_ROLE_OBSERVER=y
```
